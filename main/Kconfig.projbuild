## main/Kconfig.projbuild
```kconfig
menu "Swoosh RGB Configuration"

    config ESP_WIFI_SSID
        string "WiFi SSID"
        default "myssid"
        help
            SSID (network name) for the example to connect to.

    config ESP_WIFI_PASSWORD
        string "WiFi Password"
        default "mypassword"
        help
            WiFi password (WPA or WPA2) for the example to use.

    config ESP_MAXIMUM_RETRY
        int "Maximum retry"
        default 5
        help
            Set the Maximum retry to avoid station reconnecting to the AP unlimited when the AP is really inexistent.

    config SACN_UNIVERSE
        int "sACN Universe"
        default 1
        help
            Set the universe number for sACN E1.31 to listen on.

    config SACN_DMX_START
        int "sACN DMX Start address"
        default 1
        help
            Set the start address for sACN E1.31 to listen on.

endmenu
```
